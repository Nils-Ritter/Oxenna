## Kconfig
```kconfig
mainmenu "Oxenna Kernel Configuration"

menu "General setup"
config BUILD_KERNEL
    bool "Build the kernel"
    default y

config BUILD_TESTS
    bool "Build the kernel test image"
    default n
    depends on BUILD_KERNEL && FS_EXT2

config RELEASE_BUILD
    bool "Build an optimized release kernel"
    default n

config DEBUG_INFO
    bool "Keep debug information"
    default y
endmenu

menu "Userspace / ELF"
config ELF_SUPPORT
    bool "Enable ELF userspace support"
    default y

config ELF_ET_DYN
    bool "Enable ET_DYN / PIE executables"
    default y


config ELF_ET_EXEC
    bool "Enable ET_EXEC executables"
    default y


config USER_SYSCALLS
    bool "Enable userspace system calls"
    default y
    depends on ELF_SUPPORT

config SHELL
    bool "Build the interactive kernel shell"
    default y
    depends on FS_EXT2

endmenu

menu "Userspace applications"
config APP_HELLO
    bool "Build hello.ox"
    default y
    depends on ELF_SUPPORT && ELF_ET_DYN

config APP_FASTFETCH
    bool "Build fastfetch.ox"
    default y
    depends on ELF_SUPPORT && ELF_ET_DYN

config INSTALL_APPS
    bool "Install selected applications into /bin"
    default y
    depends on ELF_SUPPORT && FS_EXT2
endmenu

menu "Drivers"
config DRIVER_BLOCK
    bool "Block device framework"
    default y

config DRIVER_ATA
    bool "ATA PIO disk driver"
    default y
    depends on DRIVER_BLOCK
endmenu

menu "Filesystems"
config FS_EXT2
    bool "Enable ext2 filesystem"
    default y
    depends on DRIVER_BLOCK && DRIVER_ATA

config BUILD_DISK
    bool "Build the ext2 disk image"
    default y
    depends on FS_EXT2
endmenu

menu "Images and build outputs"
config BUILD_ISO
    bool "Build the bootable ISO"
    default y
    depends on BUILD_KERNEL

config BUILD_TEST_ISO
    bool "Build the test ISO when tests are enabled"
    default y
    depends on BUILD_TESTS
endmenu
```

## scripts/kconfig.py
```kconfig
#!/usr/bin/env python3
"""Small Kconfig/menuconfig implementation used by Oxenna."""
from __future__ import annotations

import argparse
import curses
import re
import sys
from dataclasses import dataclass, field
from pathlib import Path

ROOT = Path(__file__).resolve().parents[1]
KCONFIG = ROOT / "Kconfig"
DOTCONFIG = ROOT / ".config"
CONFIG_MK = ROOT / "out" / "config" / "config.mk"

# Kconfig symbols that have a matching Cargo feature.
CARGO_FEATURE_MAP = {
    "ELF_SUPPORT": "userspace",
    "USER_SYSCALLS": "userspace",
    "SHELL": "shell",
    "ELF_ET_DYN": "elf_et_dyn",
    "ELF_ET_EXEC": "elf_et_exec",
    "FS_EXT2": "fs_ext2",
    "DRIVER_BLOCK": "driver_block",
    "DRIVER_ATA": "driver_ata",
    "DRIVER_QEMU": "driver_qemu",
}

@dataclass
class Symbol:
    name: str
    prompt: str = ""
    default: bool = False
    depends: list[list[str]] = field(default_factory=list)
    value: bool = False

@dataclass
class Menu:
    title: str
    symbols: list[Symbol] = field(default_factory=list)


def parse_kconfig(path: Path):
    menus: list[Menu] = []
    current: Menu | None = None
    symbol: Symbol | None = None
    mainmenu = "Oxenna Kernel Configuration"

    for raw in path.read_text().splitlines():
        line = raw.strip()
        if not line or line.startswith("#"):
            continue
        if line.startswith("mainmenu"):
            m = re.search(r'"(.*)"', line)
            if m:
                mainmenu = m.group(1)
        elif line.startswith("menu "):
            m = re.search(r'"(.*)"', line)
            current = Menu(m.group(1) if m else line[5:].strip())
            menus.append(current)
        elif line == "endmenu":
            current = None
            symbol = None
        elif line.startswith("config "):
            if current is None:
                raise ValueError("config outside menu: " + line)
            symbol = Symbol(line.split(None, 1)[1].strip())
            current.symbols.append(symbol)
        elif line == "bool" or line.startswith("bool "):
            if symbol is None:
                raise ValueError("bool without config")
            m = re.search(r'"(.*)"', line)
            symbol.prompt = m.group(1) if m else symbol.name
        elif line.startswith("default "):
            if symbol is None:
                raise ValueError("default without config")
            symbol.default = line.split()[1].lower() in ("y", "yes", "true", "1")
        elif line.startswith("depends on "):
            if symbol is None:
                raise ValueError("depends on without config")
            expr = line[len("depends on "):].strip()
            symbol.depends.append([x.strip() for x in expr.split("&&") if x.strip()])
        else:
            raise ValueError(f"unsupported Kconfig syntax: {line}")

    return mainmenu, menus


def all_symbols(menus):
    return {s.name: s for m in menus for s in m.symbols}


def dependency_ok(sym: Symbol, symbols: dict[str, Symbol]) -> bool:
    return all(symbols.get(dep, Symbol(dep)).value for group in sym.depends for dep in group)


def normalize(symbols):
    changed = True
    while changed:
        changed = False
        for sym in symbols.values():
            if sym.value and not dependency_ok(sym, symbols):
                sym.value = False
                changed = True


def load_config(symbols):
    for sym in symbols.values():
        sym.value = sym.default

    if DOTCONFIG.exists():
        for raw in DOTCONFIG.read_text().splitlines():
            line = raw.strip()
            m = re.match(r"CONFIG_([A-Za-z0-9_]+)=(y|n)$", line)
            if m and m.group(1) in symbols:
                symbols[m.group(1)].value = m.group(2) == "y"
                continue
            m = re.match(r"# CONFIG_([A-Za-z0-9_]+) is not set$", line)
            if m and m.group(1) in symbols:
                symbols[m.group(1)].value = False

    normalize(symbols)


def save_config(symbols):
    CONFIG_MK.parent.mkdir(parents=True, exist_ok=True)

    lines = [
        "#",
        "# Automatically generated by make menuconfig / olddefconfig.",
        "#",
    ]
    for name in sorted(symbols):
        if symbols[name].value:
            lines.append(f"CONFIG_{name}=y")
        else:
            lines.append(f"# CONFIG_{name} is not set")
    DOTCONFIG.write_text("\n".join(lines) + "\n")

    features = []
    for name, feature in CARGO_FEATURE_MAP.items():
        if feature and symbols.get(name) and symbols[name].value:
            features.append(feature)

    mk = ["# Generated from .config by scripts/kconfig.py."]
    for sym in sorted(symbols.values(), key=lambda x: x.name):
        mk.append(f"CONFIG_{sym.name} := {'y' if sym.value else 'n'}")
    mk.append("CARGO_FEATURES := " + " ".join(dict.fromkeys(features)))
    mk.append("CARGO_FEATURE_ARGS := " + ("--features \"" + " ".join(dict.fromkeys(features)) + "\"" if features else ""))
    CONFIG_MK.write_text("\n".join(mk) + "\n")


def toggle(sym, symbols):
    if sym.value:
        sym.value = False
        normalize(symbols)
    elif dependency_ok(sym, symbols):
        sym.value = True


def render(stdscr, mainmenu, menus, symbols):
    curses.curs_set(0)
    stdscr.keypad(True)
    flat = [(m, s) for m in menus for s in m.symbols]
    idx = 0
    dirty = False

    while True:
        stdscr.erase()
        h, w = stdscr.getmaxyx()
        title = f" {mainmenu} "
        stdscr.addnstr(0, max(0, (w - len(title)) // 2), title, w - 1, curses.A_BOLD)
        stdscr.addnstr(1, 2, "↑/↓ or j/k: navigate   Space/Enter: toggle   S: save   Q/Esc: save & quit", w - 4)
        stdscr.addnstr(2, 2, "[ ] disabled   [-] dependency not satisfied", w - 4, curses.A_DIM)

        visible = max(1, h - 8)
        start = max(0, min(idx - visible // 2, len(flat) - visible))
        end = min(len(flat), start + visible)
        row = 4
        last_menu = None

        for i in range(start, end):
            menu, sym = flat[i]
            if menu is not last_menu:
                stdscr.addnstr(row, 3, menu.title, w - 6, curses.A_BOLD)
                row += 1
                last_menu = menu

            enabled = dependency_ok(sym, symbols)
            marker = "*" if sym.value else " "
            if not enabled:
                marker = "-"
            attr = curses.A_REVERSE if i == idx else curses.A_NORMAL
            if not enabled:
                attr |= curses.A_DIM
            stdscr.addnstr(row, 5, f"[{marker}] {sym.prompt}", w - 8, attr)
            row += 1

        if flat:
            _, current = flat[idx]
            status = "enabled" if current.value else "disabled"
            if not dependency_ok(current, symbols):
                status = "dependency not satisfied"
            deps = [d for group in current.depends for d in group]
            footer = f"{current.name}: {status}"
            if deps:
                footer += "   depends on: " + ", ".join(deps)
            stdscr.addnstr(h - 2, 2, footer, w - 4, curses.A_DIM)

        stdscr.refresh()
        key = stdscr.getch()

        if key in (ord("q"), ord("Q"), 27):
            save_config(symbols)
            return
        if key in (curses.KEY_DOWN, ord("j")):
            idx = (idx + 1) % len(flat)
        elif key in (curses.KEY_UP, ord("k")):
            idx = (idx - 1) % len(flat)
        elif key in (ord(" "), curses.KEY_ENTER, 10, 13):
            before = flat[idx][1].value
            toggle(flat[idx][1], symbols)
            dirty |= before != flat[idx][1].value
        elif key in (ord("s"), ord("S")):
            save_config(symbols)
            dirty = False
            stdscr.addnstr(h - 1, 2, "Saved .config", w - 4, curses.A_BOLD)
            stdscr.refresh()
            curses.napms(500)


def sync_config():
    _, menus = parse_kconfig(KCONFIG)
    symbols = all_symbols(menus)
    load_config(symbols)
    save_config(symbols)


def main():
    parser = argparse.ArgumentParser()
    parser.add_argument("command", choices=("menuconfig", "olddefconfig", "sync"))
    args = parser.parse_args()

    if args.command == "menuconfig":
        if not sys.stdin.isatty() or not sys.stdout.isatty():
            print("make menuconfig requires an interactive terminal", file=sys.stderr)
            return 2
        mainmenu, menus = parse_kconfig(KCONFIG)
        symbols = all_symbols(menus)
        load_config(symbols)
        curses.wrapper(render, mainmenu, menus, symbols)
        save_config(symbols)
    else:
        sync_config()

    return 0


if __name__ == "__main__":
    raise SystemExit(main())
```
